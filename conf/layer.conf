## conf/layer.conf
```bitbake
BBPATH .= ":${LAYERDIR}:${LAYERDIR}/meta-arago-distro:${LAYERDIR}/meta-arago-extras"
BBFILES += "${LAYERDIR}/meta-arago-distro/recipes*/*/*.bb \
	    ${LAYERDIR}/meta-arago-distro/recipes*/*/*.bbappend \
	    ${LAYERDIR}/meta-arago-extras/recipes*/*/*.bb \
	    ${LAYERDIR}/meta-arago-extras/recipes*/*/*.bbappend \
	   "

# Let us add layer-specific bbappends which are only applied when that
# layer is included in our configuration
BBFILES += "${@' '.join('${LAYERDIR}/%s/recipes*/*/*.bbappend' % layer \
               for layer in BBFILE_COLLECTIONS.split())}"

BBFILE_COLLECTIONS += "meta-arago"
BBFILE_PRIORITY_meta-arago = "8"
BBFILE_PATTERN_meta-arago = "^${LAYERDIR}/"
LAYERDEPENDS_meta-arago = "core meta-ti"
```
